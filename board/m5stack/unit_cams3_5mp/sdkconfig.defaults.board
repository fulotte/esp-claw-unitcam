## board/m5stack/unit_cams3_5mp/sdkconfig.defaults.board
```kconfig
# Unit CamS3-5MP Board Configuration
# ESP32-S3-WROOM-1 (N16R8): 16MB QIO Flash + 8MB Octal PSRAM

# CPU
CONFIG_ESP_DEFAULT_CPU_FREQ_MHZ_240=y

# Flash: 16MB QIO @ 80MHz
CONFIG_ESPTOOLPY_FLASHMODE_QIO=y
CONFIG_ESPTOOLPY_FLASHFREQ_80M=y
CONFIG_ESPTOOLPY_FLASHSIZE_16MB=y

# PSRAM: 8MB Octal @ 80MHz
CONFIG_SPIRAM=y
CONFIG_SPIRAM_MODE_OCT=y
CONFIG_SPIRAM_SPEED_80M=y

# Camera: OV5640 over DVP 8-bit
CONFIG_ESP_BOARD_DEV_CAMERA_SUPPORT=y
CONFIG_ESP_VIDEO_ENABLE_DVP_VIDEO_DEVICE=y
CONFIG_CAMERA_OV5640=y
CONFIG_CAMERA_OV5640_AUTO_DETECT_DVP_INTERFACE_SENSOR=y
CONFIG_CAMERA_OV5640_DVP_JPEG_1920X1080_15FPS=y
CONFIG_CAMERA_OV5640_DVP_DEFAULT_FMT_JPEG_1920X1080_15FPS=y

# Lua modules
CONFIG_APP_CLAW_LUA_MODULE_CAMERA=y
CONFIG_APP_CLAW_LUA_MODULE_IMAGE=y
CONFIG_APP_CLAW_LUA_MODULE_STORAGE=y

# Partition Table: use 16MB layout
CONFIG_PARTITION_TABLE_CUSTOM=y
CONFIG_PARTITION_TABLE_CUSTOM_FILENAME="partitions_16MB.csv"

# USB: Serial JTAG for console
CONFIG_ESP_CONSOLE_USB_SERIAL_JTAG=y
CONFIG_ESP_CONSOLE_SECONDARY_NONE=y

# WiFi: Pre-configured credentials (auto-connect on first boot)
CONFIG_APP_WIFI_SSID="1626"
CONFIG_APP_WIFI_PASSWORD="88888888"

# SSL/TLS: Required for HTTPS requests to LLM APIs
CONFIG_MBEDTLS_CERTIFICATE_BUNDLE=y
CONFIG_MBEDTLS_CERTIFICATE_BUNDLE_DEFAULT_FULL=y
CONFIG_ESP_TLS_USING_MBEDTLS=y
CONFIG_MBEDTLS_HARDWARE_AES=y
CONFIG_MBEDTLS_HARDWARE_SHA=y
CONFIG_MBEDTLS_HARDWARE_MPI=y
CONFIG_MBEDTLS_HAVE_TIME=y
CONFIG_MBEDTLS_SSL_PROTO_TLS1_2=y
CONFIG_MBEDTLS_KEY_EXCHANGE_RSA=y
CONFIG_MBEDTLS_KEY_EXCHANGE_ECDHE_RSA=y
CONFIG_MBEDTLS_KEY_EXCHANGE_ECDHE_ECDSA=y
CONFIG_MBEDTLS_ECP_DP_SECP256R1_ENABLED=y
CONFIG_MBEDTLS_ECP_DP_SECP384R1_ENABLED=y
```
